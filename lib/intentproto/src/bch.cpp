// intentproto framing v2 FEC: shortened binary BCH, n = 1023, t = 3.
//
// Construction (standard textbook BCH, from the mathematics):
//   * Field: GF(2^10) built on the primitive polynomial
//     p(x) = x^10 + x^3 + 1 (0x409); alpha = x is primitive.
//   * Generator: g(x) = lcm(m1(x), m3(x), m5(x)), the minimal
//     polynomials over GF(2) of alpha, alpha^3, alpha^5. The
//     cyclotomic cosets of 1, 3, 5 mod 1023 are disjoint and each of
//     size 10, so g has degree 30 (30 parity bits) and design
//     distance 7 (corrects t = 3).
//   * Systematic encoding: codeword c(x) = m(x)*x^30 + r(x) with
//     r(x) = m(x)*x^30 mod g(x). Data bits map MSB-first to the high
//     powers of x; the parity r occupies powers x^29..x^0.
//     Shortening to N = 8*len + 30 bits just fixes the (absent) high
//     powers at zero.
//
// Everything derived from the field — log/antilog tables, g(x), and
// the nibble-at-a-time division table for the fast path — is
// computed at build time by constexpr routines below; nothing is
// generated by external scripts and no table literal is transcribed
// from elsewhere.
//
// Decoder structure:
//   * Fast path: divide the received data by g(x) with the same
//     table-driven folding the encoder uses and XOR with the
//     received parity. The result is s(x) = v(x) mod g(x) for the
//     whole received word v; s == 0 means every syndrome is zero
//     (deg s < deg g, and g's roots include alpha^1..alpha^6), i.e.
//     a valid codeword — return immediately.
//   * Correction path (damaged frames only): syndromes
//     S_j = s(alpha^j) for j = 1,3,5 (even ones follow from the
//     binary Frobenius identity S_2j = S_j^2), Berlekamp-Massey for
//     the error locator, Chien search over the shortened positions,
//     verification, then flip the located bits.

#include "intentproto/bch.hpp"

namespace intentproto {

namespace {

// ---------------- GF(2^10) build-time arithmetic ----------------

constexpr unsigned GF_POLY = 0x409;     // x^10 + x^3 + 1
constexpr unsigned GF_ORDER = 1023;     // multiplicative group order

// Shift-and-add multiply; used only in constexpr table generation.
constexpr uint16_t gf_mul_slow(uint16_t a, uint16_t b) {
    uint32_t acc = 0, sh = a;
    while (b) {
        if (b & 1)
            acc ^= sh;
        b = (uint16_t)(b >> 1);
        sh <<= 1;
        if (sh & 0x400)
            sh ^= GF_POLY;
    }
    return (uint16_t)acc;
}

// Minimal polynomial over GF(2) of alpha^j: product of (x + alpha^c)
// over the cyclotomic coset {j*2^k mod 1023}. For j in {1,3,5} the
// coset has the full size 10, so the result has degree 10; its
// coefficients land in GF(2) and are returned as a bitmask
// (bit i = coefficient of x^i).
constexpr uint32_t minimal_poly(unsigned j) {
    uint16_t coef[11] = {1};            // running product, degree 0
    int deg = 0;
    uint16_t root = 1, apow = 2;        // root = alpha^j by ladder
    for (unsigned e = j; e; e >>= 1) {
        if (e & 1)
            root = gf_mul_slow(root, apow);
        apow = gf_mul_slow(apow, apow);
    }
    for (int k = 0; k < 10; k++) {      // conjugates: square the root
        for (int i = deg + 1; i > 0; i--)
            coef[i] = (uint16_t)(coef[i - 1] ^ gf_mul_slow(coef[i], root));
        coef[0] = gf_mul_slow(coef[0], root);
        deg++;
        root = gf_mul_slow(root, root);
    }
    uint32_t bits = 0;
    for (int i = 0; i <= deg; i++)
        if (coef[i])
            bits |= 1u << i;
    return bits;
}

// Carry-less (GF(2)[x]) polynomial product of the bitmask forms.
constexpr uint32_t poly_mul_gf2(uint32_t a, uint32_t b) {
    uint32_t r = 0;
    for (int i = 0; i < 31; i++)
        if ((b >> i) & 1)
            r ^= a << i;
    return r;
}

// g(x) = m1(x) * m3(x) * m5(x); the cosets are disjoint so the
// product is the lcm. Degree 30: bit 30 plus 30 remainder taps.
constexpr uint32_t BCH_GEN =
    poly_mul_gf2(poly_mul_gf2(minimal_poly(1), minimal_poly(3)),
                 minimal_poly(5));
static_assert(BCH_GEN == 0x50a91113, "generator polynomial drifted");
static_assert(minimal_poly(1) == GF_POLY, "alpha must be primitive");

constexpr uint32_t GEN_TAPS = BCH_GEN & 0x3fffffff;  // g minus x^30
constexpr uint32_t REM_MASK = 0x3fffffff;            // 30-bit register

// ---------------- constexpr-generated const tables ----------------
// These are the flash-resident tables: GF log/antilog for the
// correction path and a 16-entry nibble table driving the fast-path
// division (two lookups per byte). Total 4158 bytes.

struct Tables {
    uint16_t alog[GF_ORDER];    // alpha^i,               2046 bytes
    uint16_t logt[1024];        // log_alpha(v), v != 0,  2048 bytes
    uint32_t div4[16];          // mod-g(x) nibble folds,   64 bytes
};

constexpr Tables make_tables() {
    Tables t = {};
    uint16_t v = 1;
    for (unsigned i = 0; i < GF_ORDER; i++) {
        t.alog[i] = v;
        t.logt[v] = (uint16_t)i;
        v = (uint16_t)(v << 1);
        if (v & 0x400)
            v ^= GF_POLY;
    }
    t.logt[0] = 0;              // log(0) is undefined; never read
    // div4[n]: the remainder register after shifting a register
    // whose top nibble is n (rest zero) through four bit steps of
    // division by g(x).
    for (uint32_t n = 0; n < 16; n++) {
        uint32_t r = n << 26;
        for (int i = 0; i < 4; i++)
            r = (r & 0x20000000) ? (((r << 1) ^ GEN_TAPS) & REM_MASK)
                                 : ((r << 1) & REM_MASK);
        t.div4[n] = r;
    }
    return t;
}

constexpr Tables T = make_tables();

// ---------------- fast-path division ----------------
// Register invariant: after feeding the first k bits b_0..b_{k-1}
// (data bytes MSB-first), the register holds
// (sum b_i * x^(k-1-i)) * x^30 mod g(x). Feeding all data therefore
// leaves exactly the systematic parity r(x), bit p = coeff of x^p.

inline uint32_t div_byte(uint32_t r, uint8_t byte) {
    r = ((r << 4) & REM_MASK) ^ T.div4[((r >> 26) ^ (byte >> 4)) & 0xf];
    r = ((r << 4) & REM_MASK) ^ T.div4[((r >> 26) ^ byte) & 0xf];
    return r;
}

inline uint32_t div_data(const uint8_t* data, size_t len) {
    uint32_t r = 0;
    while (len--)
        r = div_byte(r, *data++);
    return r;
}

// 30 parity bits packed MSB-first: parity[0] carries x^29..x^22, …,
// parity[3] carries x^5..x^0 in its top six bits, low two bits spare.
inline uint32_t unpack_parity(const uint8_t* parity) {
    return ((uint32_t)parity[0] << 22) | ((uint32_t)parity[1] << 14)
        | ((uint32_t)parity[2] << 6) | ((uint32_t)parity[3] >> 2);
}

// ---------------- correction-path GF arithmetic ----------------

inline uint16_t gf_mul(uint16_t a, uint16_t b) {
    if (!a || !b)
        return 0;
    unsigned s = (unsigned)T.logt[a] + T.logt[b];
    if (s >= GF_ORDER)
        s -= GF_ORDER;
    return T.alog[s];
}

// a / b with b != 0.
inline uint16_t gf_div(uint16_t a, uint16_t b) {
    if (!a)
        return 0;
    unsigned s = (unsigned)T.logt[a] + GF_ORDER - T.logt[b];
    if (s >= GF_ORDER)
        s -= GF_ORDER;
    return T.alog[s];
}

// v * alpha^-1: exact inverse of the multiply-by-x reduction step.
inline uint16_t gf_div_x(uint16_t v) {
    if (v & 1)
        v ^= GF_POLY;
    return (uint16_t)(v >> 1);
}

// alpha^(e mod 1023) for e up to ~5 * 1023.
inline uint16_t gf_alog_mod(unsigned e) {
    return T.alog[e % GF_ORDER];
}

} // namespace

// ---------------- public API ----------------

void bch_encode(const uint8_t* data, size_t len, uint8_t parity[4]) {
    uint32_t r = div_data(data, len);
    parity[0] = (uint8_t)(r >> 22);
    parity[1] = (uint8_t)(r >> 14);
    parity[2] = (uint8_t)(r >> 6);
    parity[3] = (uint8_t)((r << 2) & 0xfc);
}

int bch_decode(uint8_t* data, size_t len, const uint8_t* parity) {
    // s(x) = v(x) mod g(x): the data's recomputed parity XOR the
    // received parity (deg s < 30, so no further reduction).
    uint32_t s = div_data(data, len) ^ unpack_parity(parity);
    if (s == 0)
        return 0;                       // dominant path: clean frame

    // ---- syndromes S_1..S_6 = s(alpha^j) ----
    // Only j = 1, 3, 5 need evaluation: for any binary word,
    // S_2j = S_j^2 (Frobenius).
    uint16_t S[7] = {};
    for (int j = 1; j <= 5; j += 2) {
        uint16_t acc = 0;
        for (int k = 0; k < 30; k++)
            if ((s >> k) & 1)
                acc ^= T.alog[(unsigned)j * k];     // j*k <= 145
        S[j] = acc;
    }
    S[2] = gf_mul(S[1], S[1]);
    S[4] = gf_mul(S[2], S[2]);
    S[6] = gf_mul(S[3], S[3]);

    // ---- Berlekamp-Massey: shortest LFSR C(x) generating S ----
    uint16_t C[7] = {1}, B[7] = {1}, Tmp[7];
    int L = 0, m = 1;
    uint16_t b = 1;
    for (int n = 0; n < 6; n++) {
        uint16_t d = S[n + 1];
        for (int i = 1; i <= L && i < 7; i++)
            d ^= gf_mul(C[i], S[n + 1 - i]);
        if (d == 0) {
            m++;
            continue;
        }
        for (int i = 0; i < 7; i++)
            Tmp[i] = C[i];
        uint16_t coef = gf_div(d, b);
        for (int i = 0; i + m < 7; i++)
            C[i + m] ^= gf_mul(coef, B[i]);
        if (2 * L <= n) {
            L = n + 1 - L;
            for (int i = 0; i < 7; i++)
                B[i] = Tmp[i];
            b = d;
            m = 1;
        } else {
            m++;
        }
    }
    if (L < 1 || L > BCH_T)
        return -1;                      // more damage than t = 3

    // ---- Chien search over the shortened positions ----
    // C(x) = prod(1 + alpha^p_i * x); an error at codeword power p
    // makes alpha^-p a root. Walk p = 0..N-1 evaluating C(alpha^-p)
    // incrementally (term i picks up alpha^-i per step).
    size_t nbits = 8 * len + 30;        // shortened codeword length
    uint16_t t1 = C[1], t2 = C[2], t3 = C[3];
    uint32_t pos[BCH_T];
    int nroots = 0;
    for (size_t p = 0; p < nbits; p++) {
        if ((uint16_t)(C[0] ^ t1 ^ t2 ^ t3) == 0) {
            if (nroots == L)
                return -1;              // more roots than degree
            pos[nroots++] = (uint32_t)p;
        }
        t1 = gf_div_x(t1);
        t2 = gf_div_x(gf_div_x(t2));
        t3 = gf_div_x(gf_div_x(gf_div_x(t3)));
    }
    if (nroots != L)
        return -1;      // roots missing or outside the shortening

    // ---- verify before touching the frame ----
    // The candidate pattern must reproduce the received syndromes;
    // then the corrected word has S_1..S_6 = 0, hence g | word (deg
    // of its remainder < deg g), i.e. it is a valid codeword.
    for (int j = 1; j <= 5; j += 2) {
        uint16_t sum = 0;
        for (int i = 0; i < nroots; i++)
            sum ^= gf_alog_mod((unsigned)j * pos[i]);
        if (sum != S[j])
            return -1;
    }

    // ---- apply: powers >= 30 are data bits, below 30 parity ----
    // Data bit k (MSB-first stream index) sits at power
    // 30 + (8*len - 1 - k); parity-bit corrections have no caller-
    // visible buffer and are simply counted.
    for (int i = 0; i < nroots; i++) {
        if (pos[i] < 30)
            continue;
        size_t k = 8 * len + 29 - pos[i];
        data[k >> 3] ^= (uint8_t)(0x80u >> (k & 7));
    }
    return nroots;
}

} // namespace intentproto
