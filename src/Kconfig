## src/esp32/main/Kconfig.projbuild
```kconfig
menu "Klipper firmware (FD-0001 UDP console)"

choice
    prompt "Architecture (FD-0001 doc 12)"
    default KLIPPER_ARCH_MODEM if FREERTOS_UNICORE
    default KLIPPER_ARCH_COMPONENT
    help
        How klipper shares the two cores with ESP-IDF.

config KLIPPER_ARCH_COMPONENT
    bool "component: klipper as a FreeRTOS task pinned to core 1"
    help
        The stage-1 build: IDF runs SMP FreeRTOS on both cores; the
        klipper scheduler is a high-priority task pinned to core 1
        and the console socket lives in a core-0 receive task
        (udp_port.c).  Validated build path; use this on single-core
        chip variants (ESP32-S0WD/U4WDH).

config KLIPPER_ARCH_MODEM
    bool "modem: bare-metal klipper on core 1, IDF as a network coprocessor"
    depends on FREERTOS_UNICORE
    help
        The stage-3 "IDF as modem" architecture: the IDF app is
        built unicore (enable FREERTOS_UNICORE, e.g. via
        sdkconfig.defaults.modem), core 0 only shuttles sealed
        console datagrams between the WiFi radio and a lock-free
        shared-memory ring, and core 1 is manually unstalled into a
        bare-metal klipper sched_main() - no RTOS, no IDF calls,
        register-level peripherals, IRAM-resident hot path.  HMAC
        verification runs on the klipper core; the radio-blob core
        never sees plaintext authority.  Runtime is NOT yet
        hardware-validated - see docs/ESP32.md.

endchoice

config KLIPPER_RMT_STEP
    bool "RMT step generation (hardware-timed step pulses)"
    depends on KLIPPER_ARCH_COMPONENT
    default n
    help
        Drive step generation through the RMT peripheral instead of
        toggling a step GPIO in the timer ISR (FD-0001 doc 12's "RMT
        escape hatch").  The esp32 build then compiles
        src/esp32/rmt_stepper.c in place of the portable
        src/stepper.c: the same config_stepper/queue_step command
        surface feeds (interval,count,add) triples into the RMT
        channels, whose edge timing is immune to the WiFi-stack
        timer-IRQ and flash-cache jitter that makes tick-precise
        stepping on this chip hard.  One RMT channel is consumed per
        configured stepper (8 channels total).  Component architecture
        only (the RMT refill interrupt needs esp_intr_alloc).

        Implemented but NOT yet validated on silicon - see the RMT
        section and bring-up checklist in docs/ESP32.md.  Leave this
        off to use the classic timer-IRQ stepper backend.

config KLIPPER_WIFI_SSID
    string "WiFi SSID"
    default ""
    help
        SSID of the network the board should join.

config KLIPPER_WIFI_PASSWORD
    string "WiFi password"
    default ""
    help
        WPA2 password (leave empty for an open network).

config KLIPPER_UDP_PORT
    int "UDP console port"
    default 41414
    help
        UDP port the datagram console listens on.  The host side is
        lib/intentproto/tools/udp_bridge.py --board <ip>:<port>.

config KLIPPER_DATAGRAM_SESSION
    bool "Use the authenticated rotating-key UDP session"
    default y
    help
        Offer the HELIX three-message session on top of the static HMAC
        datagram floor.  A session gives each connection fresh keys and a
        resettable replay epoch, so a board reboot can be re-established
        without coordinating static datagram sequence counters.  Hosts that
        only implement the static authenticated envelope remain compatible.

config KLIPPER_DATAGRAM_SESSION_ID
    string "UDP session board identity"
    depends on KLIPPER_DATAGRAM_SESSION
    default "esp32"
    help
        Identity authenticated by the session handshake.  Set a distinct
        value for each deployed board and require the same value at the host.

config KLIPPER_FEC_PAIR
    bool "Protect each UDP data pair with XOR parity"
    default n
    help
        Set fec_k=2 on the shared datagram console. Either single packet
        loss in a pair is reconstructed and released in order, at the cost
        of one parity packet per two data packets and one deferred-datagram
        RAM buffer. The host must also use --fec-k 2. Leave disabled until
        measurement shows the target WiFi loss profile benefits.

config KLIPPER_PSK
    string "Pre-shared key (build-time fallback)"
    default ""
    help
        HMAC pre-shared key used when none is provisioned in NVS
        (namespace "klipper", key "udp_psk").  Prefer NVS
        provisioning: a key baked into the firmware image is
        readable by anyone holding the image.

config KLIPPER_TRUST_NETWORK
    bool "TRUST NETWORK: allow unauthenticated datagrams"
    default n
    help
        Explicit confession that this board runs on an isolated,
        fully trusted network segment and may accept datagrams
        without HMAC authentication.  Anyone able to send UDP
        packets to the board then controls motors and heaters.
        Mirrors udp_bridge.py's --trust-network flag.

endmenu
```

## src/esp32/sdkconfig.defaults
```kconfig
# klipper ESP32 target defaults (RFC 0001 doc 07)

CONFIG_IDF_TARGET="esp32"

# 240MHz, performance optimized
CONFIG_ESP_DEFAULT_CPU_FREQ_MHZ_240=y
CONFIG_COMPILER_OPTIMIZATION_PERF=y

# 1kHz tick: bounds the main-task wake backstop (board irq_wait) at 1ms
CONFIG_FREERTOS_HZ=1000

# Core pinning (RFC 0001 doc 07): radio/network stack on core 0,
# klipper scheduler + hardware-timer dispatch on core 1
CONFIG_ESP_MAIN_TASK_AFFINITY_CPU0=y
CONFIG_ESP_WIFI_TASK_PINNED_TO_CORE_0=y
CONFIG_LWIP_TCPIP_TASK_AFFINITY_CPU0=y

# The klipper task on core 1 yields via task notifications; do not
# watchdog core 1's idle task
CONFIG_ESP_TASK_WDT_CHECK_IDLE_TASK_CPU1=n

# Allow gptimer alarm reprogramming from the timer ISR
CONFIG_GPTIMER_CTRL_FUNC_IN_IRAM=y

# Room for the app (WiFi stack + klipper + embedded dictionary)
CONFIG_PARTITION_TABLE_SINGLE_APP_LARGE=y

# Latency stability: no WiFi power save
CONFIG_ESP_WIFI_STA_DISCONNECTED_PM_ENABLE=n
```

## src/esp32/sdkconfig.defaults.modem
```kconfig
# Overlay defaults for the "IDF as modem" architecture (FD-0001
# doc 12 stage 3).  Build with:
#   idf.py -DSDKCONFIG_DEFAULTS="sdkconfig.defaults;sdkconfig.defaults.modem" \
#       set-target esp32 && idf.py build
# See docs/ESP32.md.

# IDF/FreeRTOS never learn core 1 exists; appcpu_boot.c releases it
# into bare-metal klipper
CONFIG_FREERTOS_UNICORE=y
CONFIG_KLIPPER_ARCH_MODEM=y
```

## src/esp32/sdkconfig.defaults.rmt
```kconfig
# Overlay defaults for the component architecture's hardware-timed RMT
# stepper backend (FD-0001 doc 12). Build with:
#   idf.py -DSDKCONFIG_DEFAULTS="sdkconfig.defaults;sdkconfig.defaults.rmt" \
#       set-target esp32 && idf.py build

CONFIG_KLIPPER_ARCH_COMPONENT=y
CONFIG_KLIPPER_RMT_STEP=y
```

## src/esp32/sdkconfig.defaults.rodent
```kconfig
# BIGTREETECH Rodent V1.1 (ESP32-WROOM-32URA-N4, 4 MiB flash)
#
# Supply credentials and the deployment PSK through an additional, untracked
# SDKCONFIG_DEFAULTS file.  This profile intentionally starts with the
# component architecture and its I2S-labelled shift-register pin backend:
# Rodent STEP/DIR/EN are serialized output bits, not direct GPIOs, and must
# not be assigned to the GPIO-only RMT backend.  I2S0 continuously clocks the
# output-state FIFO; SPI3 remains the TMC register bus.

CONFIG_ESPTOOLPY_FLASHSIZE_4MB=y
CONFIG_ESPTOOLPY_FLASHMODE_DIO=y
CONFIG_ESPTOOLPY_FLASHFREQ_40M=y

CONFIG_KLIPPER_ARCH_COMPONENT=y
CONFIG_KLIPPER_I2S_SHIFT=y
CONFIG_KLIPPER_I2S_BCK_PIN=22
CONFIG_KLIPPER_I2S_DATA_PIN=21
CONFIG_KLIPPER_I2S_WS_PIN=17
CONFIG_KLIPPER_DATAGRAM_SESSION=y
CONFIG_KLIPPER_DATAGRAM_SESSION_ID="rodent-v1.1-lab"
CONFIG_KLIPPER_SESSION_TX_COPIES=2
CONFIG_KLIPPER_UDP_PORT=41414
# Limit RF transmit peaks while the Rodent power path is qualified.  ESP-IDF
# uses quarter-dBm units: 34 = 8.5 dBm.
CONFIG_KLIPPER_WIFI_MAX_TX_POWER_QDBM=34

# Low-latency motion-command experiment. Espressif recommends disabling
# A-MPDU aggregation when disabling modem sleep alone does not bound ping
# latency. This trades bulk throughput for shorter, independently completed
# frames; HELIX's small authenticated UDP datagrams do not need aggregation.
CONFIG_ESP_WIFI_AMPDU_RX_ENABLED=n
CONFIG_ESP_WIFI_AMPDU_TX_ENABLED=n

# The first transport qualification should measure the native link before
# choosing the 50%-overhead pair-FEC profile.
CONFIG_KLIPPER_FEC_PAIR=n
```
