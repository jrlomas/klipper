## src/Kconfig
```kconfig
# Main Kconfig settings

mainmenu "Klipper Firmware Configuration"

config LOW_LEVEL_OPTIONS
    bool "Enable extra low-level configuration options"
    help
        Enable low-level configuration options that (if modified) may
        result in a build that does not function correctly.

choice
    prompt "Micro-controller Architecture"
    config MACH_AVR
        bool "Atmega AVR"
    config MACH_ATSAM
        bool "SAM3/SAM4/SAM E70"
    config MACH_ATSAMD
        bool "SAMC21/SAMD21/SAMD51/SAME5x"
    config MACH_LPC176X
        bool "LPC176x"
    config MACH_STM32
        bool "STMicroelectronics STM32"
    config MACH_HC32F460
        bool "Huada Semiconductor HC32F460"
    config MACH_RPXXXX
        bool "Raspberry Pi RP2040/RP235x"
    config MACH_PRU
        bool "Beaglebone PRU"
    config MACH_AR100
        bool "Allwinner A64 AR100"
    config MACH_LINUX
        bool "Linux process"
    config MACH_SIMU
        bool "Host simulator"
endchoice

source "src/avr/Kconfig"
source "src/atsam/Kconfig"
source "src/atsamd/Kconfig"
source "src/lpc176x/Kconfig"
source "src/stm32/Kconfig"
source "src/hc32f460/Kconfig"
source "src/rp2040/Kconfig"
source "src/pru/Kconfig"
source "src/ar100/Kconfig"
source "src/linux/Kconfig"
source "src/simulator/Kconfig"

# Generic configuration options for serial ports
config SERIAL
    bool
config SERIAL_BAUD
    depends on SERIAL
    int "Baud rate for serial port" if LOW_LEVEL_OPTIONS
    default 250000
    help
        Specify the baud rate of the serial port. This should be set
        to 250000. Read the FAQ before changing this value.

# Generic configuration options for USB
config USBSERIAL
    bool
config USBCANBUS
    bool
config USB
    bool
    default y if USBSERIAL || USBCANBUS
config USB_VENDOR_ID
    default 0x1d50
config USB_DEVICE_ID
    default 0x614e
config USB_SERIAL_NUMBER_CHIPID
    depends on USB && HAVE_CHIPID
    default y
config USB_SERIAL_NUMBER
    default "12345"

menu "USB ids"
    depends on USB && LOW_LEVEL_OPTIONS
config USB_VENDOR_ID
    hex "USB vendor ID" if USBSERIAL
config USB_DEVICE_ID
    hex "USB device ID" if USBSERIAL
config USB_SERIAL_NUMBER_CHIPID
    bool "USB serial number from CHIPID" if HAVE_CHIPID
config USB_SERIAL_NUMBER
    string "USB serial number" if !USB_SERIAL_NUMBER_CHIPID
endmenu

# Optional features that can be disabled (for devices with small flash sizes)
config WANT_ADC
    bool
    depends on HAVE_GPIO_ADC
    default y
config WANT_SPI
    bool
    depends on HAVE_GPIO && HAVE_GPIO_SPI
    default y
config WANT_SOFTWARE_SPI
    bool
    depends on WANT_SPI
    default y
config WANT_I2C
    bool
    depends on HAVE_GPIO && HAVE_GPIO_I2C
    default y
config WANT_SOFTWARE_I2C
    bool
    depends on WANT_I2C
    default y
config WANT_HARD_PWM
    bool
    depends on HAVE_GPIO_HARD_PWM
    default y
config WANT_BUTTONS
    bool
    depends on HAVE_GPIO
    default y
config WANT_TMCUART
    bool
    depends on HAVE_GPIO
    default y
config WANT_NEOPIXEL
    bool
    depends on HAVE_GPIO
    default y
config WANT_PULSE_COUNTER
    bool
    depends on HAVE_GPIO
    default y
config WANT_ST7920
    bool
    depends on HAVE_GPIO
    default y
config WANT_HD44780
    bool
    depends on HAVE_GPIO
    default y
config WANT_ADXL345
    bool
    depends on WANT_SPI
    default y
config WANT_LIS2DW
    bool
    depends on WANT_SPI || WANT_I2C
    default y
config WANT_BMI160
    bool
    depends on WANT_SPI || WANT_I2C
    default y
config WANT_MPU9250
    bool
    depends on WANT_I2C
    default y
config WANT_ICM20948
    bool
    depends on WANT_I2C
    default y
config WANT_THERMOCOUPLE
    bool
    depends on WANT_SPI
    default y
config WANT_HX71X
    bool
    depends on HAVE_GPIO
    default y
config WANT_ADS131M0X
    bool
    depends on WANT_SPI
    default y
config WANT_ADS1220
    bool
    depends on WANT_SPI
    default y
config WANT_LDC1612
    bool
    depends on WANT_I2C
    default y
config WANT_SENSOR_ANGLE
    bool
    depends on WANT_SPI
    default y
config NEED_SENSOR_BULK
    bool
    depends on WANT_ADXL345 || WANT_LIS2DW || WANT_BMI160 || WANT_MPU9250 || WANT_ICM20948 \
        || WANT_HX71X || WANT_ADS1220 || WANT_ADS131M0X || WANT_LDC1612 || WANT_SENSOR_ANGLE
    default y
config WANT_TRIGGER_ANALOG
    bool
    depends on WANT_ADC || WANT_HX71X || WANT_ADS1220 || WANT_ADS131M0X || WANT_LDC1612
    default y
config NEED_SOS_FILTER
    bool
    depends on WANT_TRIGGER_ANALOG
    default y
config WANT_TRAFFIC_CLASSES
    bool
    depends on HAVE_GPIO
    default y if !HAVE_LIMITED_CODE_SIZE
config WANT_TRAJECTORY
    bool
    depends on HAVE_GPIO && !MACH_AVR
    default y if !HAVE_LIMITED_CODE_SIZE
config WANT_TRAJECTORY_PWM
    # Sampled PWM/DAC actuator backend (FD-0001 doc 04). Needs both
    # the trajectory segment core and a hard PWM output to sample onto.
    bool
    depends on WANT_TRAJECTORY && WANT_HARD_PWM
    default y
config WANT_TRAJECTORY_HIGHER_ORDER
    # Cubic (jerk) and quintic (jerk/snap/crackle) Bezier segments on
    # top of the quadratic core (FD-0001 doc 02 "Higher-order
    # segments"). Adds j/s/c coefficient fields and the exact chained
    # integration for them; a quadratic-only build is byte-identical
    # with this off.
    bool
    depends on WANT_TRAJECTORY
    default y if !HAVE_LIMITED_CODE_SIZE
config WANT_TRACE
    # Structured trace plane (Atlas / FD-0002 §3): a registered,
    # machine-time-stamped event channel rendered to human strings on
    # the host via the data dictionary. Near-zero cost when a
    # subsystem's level is off; the ring is host-allocated, so the
    # firmware footprint is just code plus a small per-subsystem level
    # array — designed to fit the constrained F072.
    bool
    depends on HAVE_GPIO
    default y if !HAVE_LIMITED_CODE_SIZE
config WANT_SYSCALL_API
    # Unified cross-family board syscall table (FD-0001 doc 13): one
    # versioned function-pointer surface, wrapping the existing board.h
    # primitives, that every port exposes identically. Additive and small.
    bool
    depends on HAVE_GPIO
    default y if !HAVE_LIMITED_CODE_SIZE
config WANT_TRIGGER_SOURCE
    bool
    depends on HAVE_GPIO_EDGE_TRIGGER
    default y if !HAVE_LIMITED_CODE_SIZE
config WANT_HEATER_HOLD
    bool
    depends on WANT_ADC
    default y if !HAVE_LIMITED_CODE_SIZE
config WANT_BOOTLOADER
    bool
    depends on HAVE_BOOTLOADER_REQUEST
    default y if !HAVE_LIMITED_CODE_SIZE
config WANT_SIGNED_IMAGES
    bool "Signed firmware images (Ed25519)"
    depends on WANT_BOOTLOADER
    default n
    help
        Verify an Ed25519 (RFC 8032) signature over the application
        image in the first-class bootloader before marking it valid or
        booting it (FD-0001 doc 11, "Signed images") - a second gate
        beyond the transport HMAC and the whole-image CRC. The signature
        covers exactly the bytes the CRC covers and is stored in the
        validity page; the public key is embedded in the bootloader
        (keys/helix_pubkey.h) and the private key never lives on the
        device.

        The Ed25519 + SHA-512 verify adds ~6 KiB of bootloader code, so
        it does not fit the 16 KiB bootloader budget of the smallest
        parts (STM32F072/G0B1); those targets build the CRC-only
        bootloader and this option has no effect there. The bootloader
        itself is built from src/boot_app with `make bootloader SIGNED=1`,
        which defines CONFIG_WANT_SIGNED_IMAGES for that build; this
        Kconfig symbol records the intent for the application build.
        Off by default: enabling it means every accepted image must be
        signed, so provision signing keys first.

# Built-in self test: the verification gates runnable live on the board
# (docs/Helix_Test_Plan.md; host side [helix_self_test]).
config WANT_SELF_TEST
    bool "Built-in self test commands (run_self_test)"
    default y if !HAVE_LIMITED_CODE_SIZE
    default n
    help
        Register run_self_test: on-demand, protocol-driven self tests
        that execute the software verification gates live on this board
        (wire CRC vector, timer monotonicity, RAM pattern, and the
        trajectory fixed-point kernel checked against host golden
        vectors). Used at connect by the host's [helix_self_test]
        module and as a field diagnostic via HELIX_SELF_TEST. Cheap,
        safe (touches no I/O, moves nothing), and bounded.

# DTLS-class authenticated session over the datagram transport (doc 07).
config WANT_DATAGRAM_SESSION
    bool "DTLS-class session over the UDP datagram transport"
    depends on NEED_UDP_CONSOLE || MACH_LINUX
    default n
    help
        Offer the intentproto secure session (session_sec.hpp) on top of
        the static-PSK datagram floor: HKDF per-session keys, epoch key
        rotation, per-board identity, and a replay window (auth-only).
        The board is the responder; a host that never opens a session
        keeps using the static-PSK path. Once negotiated, data traffic is
        pinned to the session to prevent downgrade. Requires a PSK. Pulls
        in the session + SHA-512 code, so it is code-size sensitive. Off
        by default.

config DATAGRAM_SESSION_ID
    string "Per-board identity carried in the session handshake"
    depends on WANT_DATAGRAM_SESSION
    default "helix-board"
    help
        A short (<= 24 char) name identifying this board to the host in
        the session handshake. Give each board a distinct id.

# Serial console framing v2 (BCH FEC) — a framing transform on the UART
# console (docs/Protocol_v2.md). Opt-in, code-size sensitive (pulls in the
# BCH codec). LIVE-tested in emulation (test/console_v2_live_test.py on
# linuxprocess); silicon UART bring-up pending. Off by default.
config WANT_CONSOLE_FRAMING_V2
    bool "Accept intentproto v2 (BCH) framing on the serial UART console"
    default n
    help
        Let the board accept intentproto v2 error-correcting (BCH) framing
        on its serial UART console in addition to legacy CRC framing, and
        reply in v2 once a v2 frame is seen. This is a framing transform:
        the inner stock v1 command block and its ARQ (seq/ack/retransmit)
        are preserved; only the wire framing changes. Meaningful only for a
        byte-stream UART console (USB CDC and CAN carry their own
        integrity). Pulls in the BCH codec, so it is code-size sensitive.
        The transform is live-tested with linuxprocess; physical UART
        signal-path validation remains part of board bring-up.

# Network transports (FD-0001 doc 07): the datagram console binding
# runs unchanged over Ethernet.  These are opt-in and code-size
# sensitive - default off everywhere, and never defaulted on for
# limited-code-size boards.
config WANT_ETHERNET_W5500
    bool "Support W5500 SPI Ethernet datagram console transport"
    depends on WANT_SPI
    default n
    help
        WIZnet W5500 hardwired TCP/IP controller as a UDP datagram
        console transport - the same intentproto binding used over
        WiFi, riding a wired link.  Works on any board with an SPI bus.
        See docs/Ethernet.md.  Compile-checked, not hardware-validated.

if WANT_ETHERNET_W5500
config W5500_SPI_RATE
    int "W5500 SPI clock rate (Hz)"
    default 8000000
config W5500_TRUST_NETWORK
    bool "Run the W5500 link unauthenticated (trust_network confession)"
    default n
config W5500_PSK
    string "Pre-shared key for datagram authentication"
    default ""
config CONSOLE_W5500
    bool "Route the MCU console over the W5500 link"
    default n
    help
        Make the W5500 the board's console transport: board
        console_sendf()/console_receive_buffer() route through the
        datagram glue (as esp32/main.c does for its lwIP socket) and
        the link is brought up at startup from the static
        configuration below.  Leave off to use the W5500 as a
        secondary transport configured at runtime by config_w5500.
if CONSOLE_W5500
config W5500_SPI_BUS
    int "W5500 SPI bus index"
    default 0
config W5500_CS_PIN
    int "W5500 chip-select pin, encoded as (port-'A')*16 + num (PA4=4)"
    default 4
config W5500_UDP_PORT
    int "W5500 UDP listen port"
    default 1234
config W5500_IP
    hex "Static IPv4 address (0xC0A800FE == 192.168.0.254)"
    default 0xC0A800FE
config W5500_NETMASK
    hex "Static IPv4 netmask"
    default 0xFFFFFF00
config W5500_GATEWAY
    hex "Static IPv4 gateway"
    default 0xC0A80001
endif # CONSOLE_W5500
endif # WANT_ETHERNET_W5500

# Native on-chip Ethernet MAC + external RMII PHY path (needs a
# software IP stack).  HAVE_ETH_MAC is set by ports with a built-in MAC.
config HAVE_ETH_MAC
    bool
config WANT_ETHERNET_RMII
    bool "Support native RMII Ethernet MAC datagram console (design seam)"
    depends on HAVE_ETH_MAC
    default n
    help
        Native on-chip Ethernet MAC driving an external RMII PHY.
        Ships the MAC/DMA descriptor-ring bring-up skeleton
        (stm32/eth_mac.c) and a minimal built-in UDP/IP/ARP responder
        (generic/nano_udp.c) as the pluggable IP layer; the MAC DMA
        bring-up is a clearly-marked TODO seam where lwIP or the
        built-in responder plugs in.  See docs/Ethernet.md.
config WANT_NANO_UDP
    bool
    default y if WANT_ETHERNET_RMII
# The datagram-console glue (generic/udp_console.c + the C++ intentproto
# codec) is shared by every network transport
config NEED_UDP_CONSOLE
    bool
    default y if WANT_ETHERNET_W5500 || WANT_ETHERNET_RMII

menu "Optional features (to reduce code size)"
    depends on HAVE_LIMITED_CODE_SIZE
config WANT_ADC
    bool "Support micro-controller based ADC (analog to digital)"
    depends on HAVE_GPIO_ADC
config WANT_SPI
    bool "Support communicating with external chips via SPI bus"
    depends on HAVE_GPIO && HAVE_GPIO_SPI
config WANT_SOFTWARE_SPI
    bool "Support software based SPI \"bit-banging\""
    depends on WANT_SPI
config WANT_I2C
    bool "Support communicating with external chips via I2C bus"
    depends on HAVE_GPIO && HAVE_GPIO_I2C
config WANT_SOFTWARE_I2C
    bool "Support software based I2C \"bit-banging\""
    depends on WANT_I2C
config WANT_HARD_PWM
    bool "Support hardware PWM (pulse width modulation)"
    depends on HAVE_GPIO_HARD_PWM
config WANT_BUTTONS
    bool "Support GPIO based button reading"
    depends on HAVE_GPIO
config WANT_TMCUART
    bool "Support Trinamic stepper motor driver UART communication"
    depends on HAVE_GPIO
config WANT_NEOPIXEL
    bool "Support 'neopixel' type LED control"
    depends on HAVE_GPIO
config WANT_PULSE_COUNTER
    bool "Support measuring fan tachometer GPIO pins"
    depends on HAVE_GPIO
comment "LCD chips"
config WANT_ST7920
    bool "Support ST7920 LCD display"
    depends on HAVE_GPIO
config WANT_HD44780
    bool "Support HD44780 LCD display"
    depends on HAVE_GPIO
comment "Accelerometer chips"
    depends on WANT_SPI || WANT_I2C
config WANT_ADXL345
    bool "Support adxl accelerometers"
    depends on WANT_SPI
config WANT_LIS2DW
    bool "Support lis2dw and lis3dh 3-axis accelerometers"
    depends on WANT_SPI || WANT_I2C
config WANT_BMI160
    bool "Support BMI160 accelerometer"
    depends on WANT_SPI || WANT_I2C
config WANT_MPU9250
    bool "Support MPU accelerometers"
    depends on WANT_I2C
config WANT_ICM20948
    bool "Support ICM20948 accelerometer"
    depends on WANT_I2C
comment "External ADC type chips"
config WANT_THERMOCOUPLE
    bool "Support thermocouple MAX sensors"
    depends on WANT_SPI
config WANT_HX71X
    bool "Support HX711 and HX717 ADC chips"
    depends on HAVE_GPIO
config WANT_ADS131M0X
    bool "Support ADS 131M02/M04 ADC chips"
    depends on WANT_SPI
config WANT_ADS1220
    bool "Support ADS 1220 ADC chip"
    depends on WANT_SPI
comment "Other external sensor chips"
    depends on WANT_SPI || WANT_I2C
config WANT_LDC1612
    bool "Support ldc1612 eddy current sensor"
    depends on WANT_I2C
config WANT_SENSOR_ANGLE
    bool "Support angle sensors"
    depends on WANT_SPI
comment "Other features"
    depends on WANT_ADC || WANT_HX71X || WANT_ADS1220 || WANT_ADS131M0X || WANT_LDC1612
config WANT_TRIGGER_ANALOG
    bool "Support for homing/probing events using analog sensors"
    depends on WANT_ADC || WANT_HX71X || WANT_ADS1220 || WANT_ADS131M0X || WANT_LDC1612
config WANT_TRAFFIC_CLASSES
    bool "Support traffic-class prompt outputs (degrade instead of shutdown)"
    depends on HAVE_GPIO
config WANT_TRAJECTORY
    bool "Support trajectory intention segments"
    depends on HAVE_GPIO && !MACH_AVR
config WANT_TRAJECTORY_HIGHER_ORDER
    bool "Support cubic/quintic (jerk-limited) trajectory segments"
    depends on WANT_TRAJECTORY
config WANT_SYSCALL_API
    bool "Support the unified cross-family board syscall table"
    depends on HAVE_GPIO
config WANT_TRIGGER_SOURCE
    bool "Support hardware event trigger sources"
    depends on HAVE_GPIO_EDGE_TRIGGER
config WANT_HEATER_HOLD
    bool "Support autonomous heater failsafe hold"
    depends on WANT_ADC
config WANT_BOOTLOADER
    bool "Support in-band bootloader entry (enter_bootloader)"
    depends on HAVE_BOOTLOADER_REQUEST
endmenu

# Generic configuration options for CANbus
config CANSERIAL
    bool
config CANBUS
    bool
    default y if CANSERIAL || USBCANBUS
config CANBUS_FREQUENCY
    int "CAN bus speed" if LOW_LEVEL_OPTIONS && CANBUS
    default 1000000
config CANBUS_FILTER
    bool
    default y if CANSERIAL

# Stepper optimizations
config INLINE_STEPPER_HACK
    # Enables gcc to inline stepper_event() into the main timer irq handler
    bool
    depends on HAVE_GPIO
    default y
config HAVE_STEPPER_OPTIMIZED_BOTH_EDGE
    bool
config WANT_STEPPER_OPTIMIZED_BOTH_EDGE
    bool "Optimize stepper code for 'step on both edges'" if LOW_LEVEL_OPTIONS
    depends on INLINE_STEPPER_HACK && HAVE_STEPPER_OPTIMIZED_BOTH_EDGE
    default y
    help
        Optimize the stepper code for Trinamic stepper motor drivers
        that are configured in UART or SPI mode (and thus can perform
        a step on both "edges" of the step pin).  Enabling this option
        typically improves the stepper cpu performance by about 20%
        when using these drivers.  If this option is disabled the code
        will instead deploy optimizations that improve the cpu
        performance by about 20% for traditional drivers (those that
        take a step only on the "rising" or "falling" level of the
        step pin).

# Support setting gpio state at startup
config INITIAL_PINS
    string "GPIO pins to set at micro-controller startup"
    depends on LOW_LEVEL_OPTIONS
    help
        One may specify a comma separated list of gpio pins to set
        during the micro-controller startup sequence. By default the
        pins will be set to output high - preface a pin with a '!'
        character to set that pin to output low.

# The HAVE_x options allow boards to disable support for some commands
# if the hardware does not support the feature.
config HAVE_GPIO
    bool
config HAVE_GPIO_ADC
    bool
config HAVE_GPIO_SPI
    bool
config HAVE_GPIO_SDIO
    bool
config HAVE_GPIO_I2C
    bool
config HAVE_GPIO_HARD_PWM
    bool
config HAVE_GPIO_EDGE_TRIGGER
    bool
config HAVE_STRICT_TIMING
    bool
config HAVE_CHIPID
    bool
config HAVE_BOOTLOADER_REQUEST
    bool
config HAVE_LIMITED_CODE_SIZE
    bool
config HAVE_SOFTWARE_DIVIDE_REQUIRED
    bool
```
